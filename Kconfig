## Kconfig
```kconfig
menu "WiFi Logger configuration"

choice LOGGING_SERVER_TRANSPORT_PROTOCOL
    prompt "Network protocol (TCP/UDP/WEBSOCKET)"
    default LOGGING_SERVER_TRANSPORT_PROTOCOL_UDP
    help
        "Network protocol to be used to relay log messages, either use UDP or TCP."

    config LOGGING_SERVER_TRANSPORT_PROTOCOL_UDP
        bool "UDP"

    config LOGGING_SERVER_TRANSPORT_PROTOCOL_TCP
        bool "TCP"

    config LOGGING_SERVER_TRANSPORT_PROTOCOL_WEBSOCKET
        bool "WEBSOCKET"

endchoice

config LOGGING_SERVER_MESSAGE_QUEUE_SIZE
    help
        "Each queue item is one line of log output. This size only matters when network is down, or, having trouble sending"
    int "Queue Size"
    default 256

config LOGGING_SERVER_BUFFER_MAX_SIZE
    int "logger buffer max size"
    help
        "Max #chars to store in a line of log text. beyond this, output will be truncated until next newline. Try and keep short, if possible."

    default 256
        
endmenu
```
